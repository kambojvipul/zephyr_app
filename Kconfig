## Kconfig
```kconfig
mainmenu "Customized Mainmenu"

source "Kconfig.zephyr"

menu "FW Challenge Options"

config APP_SAMPLE_INTERVAL_MS
    int "Sample Interval (ms)"
    default 2000
    help
      This option provide internal ms.

config APP_ENABLE_BLE
    bool "Enable BLE"
    default n
    help
      Enable BLE.

config APP_LED_ACTIVE_LOW
    bool "LED Active Low"
    default y
    help
      Set the Active Low.

endmenu
```

## boards/xiao_esp32c3.conf
```kconfig
CONFIG_LOG=y	
CONFIG_LED=y
CONFIG_LED_PWM=y
CONFIG_PINCTRL=y

# Enable the generic Serial and Console subsystems
CONFIG_SERIAL=y
CONFIG_CONSOLE=y
CONFIG_UART_CONSOLE=y

CONFIG_BOOTLOADER_MCUBOOT=y
CONFIG_APP_SAMPLE_INTERVAL_MS=2000
CONFIG_APP_ENABLE_BLE=y
CONFIG_APP_LED_ACTIVE_LOW=n
CONFIG_ADC=y

#BLE CONFIGS
CONFIG_BT=y
CONFIG_BT_PERIPHERAL=y 
CONFIG_BT_DEVICE_NAME="FW-CHALLENGE"
CONFIG_BT_DEVICE_NAME_DYNAMIC=y


# Enable NVS (Non-Volatile Storage) for Bluetooth settings, often required
CONFIG_SETTINGS=y
CONFIG_FLASH=y
CONFIG_NVS=y
CONFIG_CRC=y

CONFIG_REBOOT=y
```

## build/Kconfig/arch/Kconfig
```kconfig
# Load Zephyr Arch Kconfig descriptions.
osource "/home/vipul/zephyrproject/zephyr/arch/rx/Kconfig"
osource "/home/vipul/zephyrproject/zephyr/arch/x86/Kconfig"
osource "/home/vipul/zephyrproject/zephyr/arch/xtensa/Kconfig"
osource "/home/vipul/zephyrproject/zephyr/arch/sparc/Kconfig"
osource "/home/vipul/zephyrproject/zephyr/arch/riscv/Kconfig"
osource "/home/vipul/zephyrproject/zephyr/arch/posix/Kconfig"
osource "/home/vipul/zephyrproject/zephyr/arch/mips/Kconfig"
osource "/home/vipul/zephyrproject/zephyr/arch/arm64/Kconfig"
osource "/home/vipul/zephyrproject/zephyr/arch/arm/Kconfig"
osource "/home/vipul/zephyrproject/zephyr/arch/arc/Kconfig"
```

## build/Kconfig/boards/Kconfig
```kconfig
# Load Zephyr board Kconfig descriptions.
osource "/home/vipul/zephyrproject/zephyr/boards/espressif/esp32_devkitc/Kconfig"
```

## build/Kconfig/boards/Kconfig.defconfig
```kconfig
# Load Zephyr board defconfig descriptions.
osource "/home/vipul/zephyrproject/zephyr/boards/espressif/esp32_devkitc/Kconfig.defconfig"
```

## build/Kconfig/boards/Kconfig.esp32_devkitc
```kconfig
# Load board Kconfig descriptions.
osource "/home/vipul/zephyrproject/zephyr/boards/espressif/esp32_devkitc/Kconfig.esp32_devkitc"
```

## dts/bindings/app/config.yaml
```yaml
compatible: "app,config"
description: Custom app configuration node
properties:
  sample-interval-ms:
    type: int
    required: true
  voltage-threshold-mv:
    type: int
    required: true
  enable-ble:
    type: boolean
    required: false
```
